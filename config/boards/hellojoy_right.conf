## config/boards/hellojoy_right.conf
```kconfig
CONFIG_BT=y
CONFIG_ZMK_BLE=y
CONFIG_ZMK_SPLIT=y
CONFIG_ZMK_SPLIT_BLE=y
CONFIG_ZMK_SPLIT_BLE_ROLE_PERIPHERAL=y
CONFIG_ZMK_BLE_INIT_ADVERTISING=y
CONFIG_ZMK_BATTERY_REPORTING=y
```

## config/boards/shields/hellojoy/Kconfig.defconfig
```kconfig
# Copyright (c) 2022 Duccio Breschi
# SPDX-License-Identifier: MIT

if SHIELD_HONEYYANG

config ZMK_KEYBOARD_NAME
    default "honeyYang"

endif
```

## config/boards/shields/hellojoy/Kconfig.shield
```kconfig
# Copyright (c) 2022 Duccio Breschi
# SPDX-License-Identifier: MIT

config SHIELD_HELLOJOY
    def_bool $(shields_list_contains,hellojoy)
```
