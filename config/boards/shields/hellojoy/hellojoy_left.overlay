/*
 * Copyright (c) 2022 Duccio Breschi
 *
 * SPDX-License-Identifier: MIT
 */


#include "hellojoy.dtsi"
 
&kscan0 {
    compatible = "zmk,kscan-gpio-matrix";
    wakeup-source;
    label = "KSCAN";
    diode-direction = "col2row";

    col-gpios
        = <&gpio0 31 GPIO_ACTIVE_HIGH>  // COL0 - P0.31/AIN7
        , <&gpio0 29 GPIO_ACTIVE_HIGH>  // COL1 - P0.29/AIN5
        , <&gpio0 2  GPIO_ACTIVE_HIGH>  // COL2 - P0.02/AIN0
        , <&gpio1 15 GPIO_ACTIVE_HIGH>  // COL3 - P1.15
        , <&gpio1 13 GPIO_ACTIVE_HIGH>  // COL4 - P1.13
        , <&gpio1 11  GPIO_ACTIVE_HIGH>  // COL5 - P1.06
        , <&gpio0 10  GPIO_ACTIVE_HIGH>  // COL6 - P1.04
        , <&gpio0 9 GPIO_ACTIVE_HIGH>  
        , <&gpio1 6 GPIO_ACTIVE_HIGH> 
        , <&gpio1 4 GPIO_ACTIVE_HIGH> 
        ;

    row-gpios
        = <&gpio0 8  (GPIO_ACTIVE_HIGH | GPIO_PULL_DOWN)> 
        , <&gpio0 6  (GPIO_ACTIVE_HIGH | GPIO_PULL_DOWN)>  
        , <&gpio0 17  (GPIO_ACTIVE_HIGH | GPIO_PULL_DOWN)>       
        , <&gpio0 20 (GPIO_ACTIVE_HIGH | GPIO_PULL_DOWN)> 
        , <&gpio0 22 (GPIO_ACTIVE_HIGH | GPIO_PULL_DOWN)>  
        , <&gpio0 24 (GPIO_ACTIVE_HIGH | GPIO_PULL_DOWN)>
        ;
};





